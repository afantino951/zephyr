## dts/bindings/base/zephyr,domains.yaml
```yaml
# Copyright (c) Qualcomm Technologies, Inc. and/or its subsidiaries.
# SPDX-License-Identifier: Apache-2.0

description: |
  Domains

compatible: "zephyr,domains"

include: base.yaml

child-binding:
  properties:
    cpus:
      type: phandles
      required: true
      description: |
        The cpus which the domain applies.

    execution-memory:
      type: phandle
      description: |
        Phandle to the memory region or partition from which CPU1 will execute.

    source-memory:
      type: phandle
      description: |
        Phandle to the memory region or partition from which the CPU1 code will be
        loaded into execution-memory.

examples:
  - |
    /* With Image Relocation */
    domains {
      compatible = "zephyr,domains";

      cpu-1 {
        cpus = <&cpu1>;
        execution-memory = <&sram0_cpu1>;
        source-memory = <&cpu1_slot0_partition>;
      };
    };
  - |
    /* No Image Relocation necessary */
    domains {
      compatible = "zephyr,domains";

      cpu-1 {
        cpus = <&cpu1>;
        execution-memory = <&cpu1_slot0_partition>;
      };
    };
  - |
    /* Domain node with multiple CPUs (other image runs SMP) */
    domains {
      compatible = "zephyr,domains";

      cpu-1 {
        cpus = <&cpu1 &cpu2>;
        execution-memory = <&cpu1_slot0_partition>;
      };
    };
```

## dts/bindings/cpu/enable-method/raspberrypi,rpi-pico-cpu1.yaml
```yaml
# Copyright (c) Qualcomm Technologies, Inc. and/or its subsidiaries.
# SPDX-License-Identifier: Apache-2.0

title: Raspberry Pi Pico series secondary CPU enable-method

description: |
  The Raspberry Pi Pico family of SoCs uses a series of SIO inter-processor FIFO
  reads/writes to bring the second core (CPU1) out of its quiescent state. The
  launch sequence points CPU1 to its stack pointer and program counter.

  CPU0 is responsible for relocating CPU1's image if necessary. For
  example, if CPU1 is built to execute from SRAM, but is loaded into flash.

  Sample usage

  &cpu1 {
      compatible = "raspberrypi,rpi-pico-cpu1", "arm,cortex-m33";
      enable-method = "raspberrypi,rpi-pico-cpu1";
      execution-memory = <&sram0_cpu1>;
      source-memory = <&cpu1_slot0_partition>;
      status = "okay";
  };

compatible: "raspberrypi,rpi-pico-cpu1"

include: cpu.yaml

properties:
  enable-method:
    const: "raspberrypi,rpi-pico-cpu1"

  execution-memory:
    type: phandle
    required: true
    description: |
      Phandle to the memory region or partition from which CPU1 will execute.

  source-memory:
    type: phandle
    description: |
      Phandle to the memory region or partition from which the CPU1 code will be
      loaded into execution-memory.
```

## dts/bindings/cpu_enable/cpu-enable.yaml
```yaml
# Copyright (c) Qualcomm Technologies, Inc. and/or its subsidiaries.
# SPDX-License-Identifier: Apache-2.0

include: base.yaml

properties:
  cpu:
    type: phandle
    required: true
    description: |
      Phandle to the /cpus/cpu* node this node brings up.

  execution-memory:
    type: phandle
    description: |
      Phandle to the memory region or partition from which the secondary CPU executes.

  source-memory:
    type: phandle
    description: |
      Phandle to the memory region or partition from which the secondary CPU's image is
      copied into execution-memory.
```

## dts/bindings/cpu_enable/raspberrypi,pico-pcbs.yaml
```yaml
# Copyright (c) Qualcomm Technologies, Inc. and/or its subsidiaries.
# SPDX-License-Identifier: Apache-2.0

title: Raspberry Pi Pico Processor Controlled Boot Sequence

description: |
  The Raspberry Pi Pico family of SoCs uses a series of SIO inter-processor
  FIFO reads/writes to bring CPU1 out of its quiescent state. The launch
  sequence points CPU1 to its stack pointer and program counter.

  CPU0 is responsible for relocating CPU1's image if necessary (e.g. if
  CPU1 is built to execute from SRAM but is loaded into flash).

  Example:

    / {
        cpu1_en: cpu1-en {
            compatible = "raspberrypi,pico-pcbs";
            cpu = <&cpu1>;
            execution-memory = <&sram0_cpu1>;
            source-memory = <&cpu1_slot0_partition>;
            status = "okay";
        };
    };

compatible: "raspberrypi,pico-pcbs"

include: cpu-enable.yaml

properties:
  execution-memory:
    required: true
```

## soc/raspberrypi/rpi_pico/common/Kconfig.cpu1
```kconfig
# Copyright (c) Qualcomm Technologies, Inc. and/or its subsidiaries.
# SPDX-License-Identifier: Apache-2.0

config SOC_FAMILY_RPI_PICO_CPU1
	bool
	help
	  Hidden marker selected by every CPU1-side SoC variant. Used to
	  gate Kconfig options that are only meaningful in CPU0 images,
	  such as SOC_RPI_PICO_CPU1_ENABLE.

config SOC_RPI_PICO_CPU1_ENABLE
	bool "Boot the second CPU core"
	depends on $(dt_nodelabel_enabled_with_compat,cpu1,$(DT_COMPAT_RASPBERRYPI_RPI_PICO_CPU1)) \
		&& !SOC_FAMILY_RPI_PICO_CPU1
	default y
	# select SOC_LATE_INIT_HOOK
	select SOC_EARLY_INIT_HOOK
	help
	  If enabled, the second CPU will be powered up and pointed to its
	  application entrypoint during SoC late init hook.

if SOC_RPI_PICO_CPU1_ENABLE

config SOC_RPI_PICO_CPU1_ENABLE_CHECK_VTOR
	bool "Check VTOR before booting the second core"
	default y
	help
	  Verify that VTOR pointers are valid before booting the second CPU.

endif # SOC_RPI_PICO_CPU1_ENABLE
```
